## software/boards/others/ledstrip/board.yml
```yaml
board:
  name: ledstrip
  full_name: LED strip controller
  vendor: others
  socs:
    - name: stm32g030xx
```

## software/west.yml
```yaml
manifest:
  version: "1.2"

  projects:
    - name: zephyr
      url: https://github.com/zephyrproject-rtos/zephyr
      revision: v4.4.2
      path: zephyr
      import:
        path-prefix: software/ext
        name-allowlist:
          - cmsis_6
          - hal_stm32

  self:
    path: software
```
